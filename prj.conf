## CMakeLists.txt
```
cmake_minimum_required(VERSION 3.13.1)
find_package(Zephyr REQUIRED HINTS $ENV{ZEPHYR_BASE})
project(sandbox)

FILE(GLOB_RECURSE app_sources
    src/*.c
    src/*.cpp
    src/*.h)
target_sources(app PRIVATE ${app_sources})
```

## prj.conf
```kconfig
# Logging
CONFIG_LOG=y
CONFIG_LOG_IMMEDIATE=y 

# Kernel options
CONFIG_MAIN_STACK_SIZE=2048
CONFIG_INIT_STACKS=y
CONFIG_FPU=y

# C/C++ Library
CONFIG_NEWLIB_LIBC=y
CONFIG_CPLUSPLUS=y
CONFIG_STD_CPP17=y
CONFIG_LIB_CPLUSPLUS=y
CONFIG_RTTI=y
# CONFIG_EXCEPTIONS is not set

# Debug
# CONFIG_DEBUG_INFO=y
# CONFIG_OPENOCD_SUPPORT=y
# CONFIG_THREAD_STACK_INFO=y
# CONFIG_THREAD_MONITOR=y
# CONFIG_THREAD_NAME=y
```

## src/main.cpp
```c
#include <logging/log.h>
LOG_MODULE_REGISTER(sandbox, LOG_LEVEL_INF);

#include "thread.hh"

#include "memory.hh"
#include "memory/slab_test.hh"

#include "chrono.hh"
using namespace std::chrono_literals;

#include <zephyr.h>

void main(void) {
    LOG_INF("Testing Memory::Slab::Allocator...");
    Test_Slab();
    LOG_INF("Success!");

    while (1) {
        std::this_thread::sleep_for(1000ms);
    }
}
```
